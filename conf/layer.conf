## conf/layer.conf
```bitbake
# We have a conf and classes directory, add to BBPATH
BBPATH .= ":${LAYERDIR}"

# We have recipes-* directories, add to BBFILES
BBFILES += "${LAYERDIR}/recipes-*/*/*.bb \
        ${LAYERDIR}/recipes-*/*/*.bbappend"

BBFILE_COLLECTIONS += "honda"
BBFILE_PATTERN_honda = "^${LAYERDIR}/"
BBFILE_PRIORITY_honda = "1"

# This should only be incremented on significant changes that will
# cause compatibility issues with other layers
LAYERVERSION_honda = "1"

LAYERDEPENDS_honda = "core"
LAYERSERIES_COMPAT_honda = "mickledore scarthgap"
```
